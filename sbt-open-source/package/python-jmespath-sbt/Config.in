## sbt-open-source/package/python-jmespath-sbt/Config.in
```kconfig
config BR2_PACKAGE_PYTHON_JMESPATH_SBT
	bool "python-jmespath-sbt"
	help
	  JMESPath is a query language for JSON.

	  http://jmespath.org/
```

## sbt-open-source/package/python-jsonpatch/Config.in
```kconfig
config BR2_PACKAGE_PYTHON_JSONPATCH
	bool "python-jsonpatch"
	select BR2_PACKAGE_PYTHON_JSONPOINTER
	help
	  Applying JSON Patches in Python.

	  https://github.com/stefankoegl/python-json-patch
```

## sbt-open-source/package/python-jsonpointer/Config.in
```kconfig
config BR2_PACKAGE_PYTHON_JSONPOINTER
	bool "python-jsonpointer"
	help
	  Resolve JSON Pointers in Python.

	  https://github.com/stefankoegl/python-json-pointer
```

## sbt-open-source/package/python-multidict-sbt/Config.in
```kconfig
config BR2_PACKAGE_PYTHON_MULTIDICT_SBT
	bool "python-multidict-sbt"
	depends on BR2_PACKAGE_PYTHON3
	help
	  Multidict is dict-like collection of key-value pairs where a
	  key may occur more than once in the container.

	  https://github.com/aio-libs/multidict
```

## sbt-open-source/package/python-pydantic-sbt/Config.in
```kconfig
config BR2_PACKAGE_PYTHON_PYDANTIC_SBT
	bool "python-pydantic-sbt"
	depends on BR2_PACKAGE_PYTHON3
	help
	  Data validation and settings management using python 3.6
	  type hinting.

	  https://github.com/samuelcolvin/pydantic
```

## sbt-open-source/package/python-pympler/Config.in
```kconfig
config BR2_PACKAGE_PYTHON_PYMPLER
	bool "python-pympler"
	help
	  A development tool to measure, monitor and
	  analyze the memory behavior of Python objects.

	  http://pythonhosted.org/Pympler/
```

## sbt-open-source/package/python-qasync/Config.in
```kconfig
config BR2_PACKAGE_PYTHON_QASYNC
	bool "python-qasync"
	help
	  qasync allows coroutines to be used in PyQt/PySide applications by
	  providing an implementation of the PEP 3156 event-loop.

	  https://github.com/CabbageDevelopment/qasync
```

## sbt-open-source/package/python-qtawesome/Config.in
```kconfig
config BR2_PACKAGE_PYTHON_QTAWESOME
	bool "python-qtawesome"
	select BR2_PACKAGE_PYTHON_QTPY # runtime
	select BR2_PACKAGE_PYTHON_SIX # runtime
	help
	  Iconic fonts in PyQt and PySide applications

	  https://github.com/spyder-ide/qtawesome
```

## sbt-open-source/package/python-qtpy/Config.in
```kconfig
config BR2_PACKAGE_PYTHON_QTPY
	bool "python-qtpy"
	help
	  Provides an uniform layer to support PyQt5, PySide2, PyQt4 and PySide with a single codebase.

	  https://github.com/spyder-ide/qtpy
```

## sbt-open-source/package/python-restrictedpython/Config.in
```kconfig
config BR2_PACKAGE_PYTHON_RESTRICTEDPYTHON
	bool "python-restrictedpython"
	help
	  A restricted execution environment for Python to run untrusted code.

	  http://restrictedpython.readthedocs.io/
```

## sbt-open-source/package/python-rxpy-sbt/Config.in
```kconfig
config BR2_PACKAGE_PYTHON_RXPY_SBT
	bool "python-rxpy-sbt"
	help
	  RxPY is a library for composing asynchronous and event-based programs using observable collections and pipable query operators in Python.

	  https://rxpy.readthedocs.io/en/latest/
```

## sbt-open-source/package/python-rxpy/Config.in
```kconfig
config BR2_PACKAGE_PYTHON_RXPY
	bool "python-rxpy"
	help
	  RxPY is a library for composing asynchronous and event-based programs using observable collections and pipable query operators in Python.

	  https://rxpy.readthedocs.io/en/latest/
```

## sbt-open-source/package/python-swu-client/Config.in
```kconfig
config BR2_PACKAGE_PYTHON_SWU_CLIENT
	bool "python-swu-client"
	select BR2_PACKAGE_PYTHON_AIOHTTP # runtime
	help
	  Simple client for the SWUpdat HTTP service
```

## sbt-open-source/package/python-tinydb/Config.in
```kconfig
config BR2_PACKAGE_PYTHON_TINYDB
	bool "python-tinydb"
	select BR2_PACKAGE_PYTHON_TINYDB
	help
	  A lightweight document-oriented database written in pure Python.

	  https://github.com/msiemens/tinydb
```

## sbt-open-source/package/python-typing-extensions/Config.in
```kconfig
config BR2_PACKAGE_PYTHON_TYPING_EXTENSIONS
	bool "python-typing-extensions"
	help
	  Work related to PEP 484: typing.py (released via PyPI) and issue tracker

	  https://github.com/python/typing
```

## sbt-open-source/package/python-utmp/Config.in
```kconfig
config BR2_PACKAGE_PYTHON_UTMP
	bool "python-utmp"
	help
	  Pure-Python library to decode/read utmp and wtmp files.
```

## sbt-open-source/package/telegraf/Config.in
```kconfig
config BR2_PACKAGE_TELEGRAF
	bool "telegraf"
	help
	  The plugin-driven server agent for collecting & reporting metrics.

	  https://influxdata.com

config BR2_PACKAGE_TELEGRAF_COMPRESS_BINARIES
	bool "attempt to shrink the resulting binaries"
```

## sbt-proprietary/Config.in
```kconfig
source "$BR2_EXTERNAL_SBT_PROPRIETARY_PATH/package/alg/Config.in"
source "$BR2_EXTERNAL_SBT_PROPRIETARY_PATH/package/bactobox-config/Config.in"
source "$BR2_EXTERNAL_SBT_PROPRIETARY_PATH/package/python-algpy/Config.in"
source "$BR2_EXTERNAL_SBT_PROPRIETARY_PATH/package/python-baxter/Config.in"
source "$BR2_EXTERNAL_SBT_PROPRIETARY_PATH/package/python-cellmate/Config.in"
source "$BR2_EXTERNAL_SBT_PROPRIETARY_PATH/package/python-frog/Config.in"
source "$BR2_EXTERNAL_SBT_PROPRIETARY_PATH/package/python-dash/Config.in"
source "$BR2_EXTERNAL_SBT_PROPRIETARY_PATH/package/python-dash38/Config.in"
source "$BR2_EXTERNAL_SBT_PROPRIETARY_PATH/package/python-geist/Config.in"
source "$BR2_EXTERNAL_SBT_PROPRIETARY_PATH/package/python-maskin/Config.in"
source "$BR2_EXTERNAL_SBT_PROPRIETARY_PATH/package/python-mester/Config.in"
source "$BR2_EXTERNAL_SBT_PROPRIETARY_PATH/package/python-staten/Config.in"
source "$BR2_EXTERNAL_SBT_PROPRIETARY_PATH/package/rm-neue/Config.in"
source "$BR2_EXTERNAL_SBT_PROPRIETARY_PATH/package/zeus-config/Config.in"
```

## sbt-proprietary/configs/zeus_defconfig
```kconfig
BR2_arm=y
BR2_cortex_a9=y
BR2_ARM_ENABLE_NEON=y
BR2_ARM_ENABLE_VFP=y
BR2_ARM_FPU_NEON=y
BR2_SVN="svn"
BR2_KERNEL_MIRROR="http://www.kernel.org/pub"
BR2_GNU_MIRROR="http://ftp.gnu.org/pub/gnu"
BR2_LUAROCKS_MIRROR="http://luarocks.org/repositories/rocks"
BR2_JLEVEL=4
BR2_OPTIMIZE_3=y
BR2_PACKAGE_OVERRIDE_FILE="$(TOPDIR)/local.mk"
BR2_TOOLCHAIN_EXTERNAL=y
BR2_TOOLCHAIN_EXTERNAL_CUSTOM=y
BR2_TOOLCHAIN_EXTERNAL_PATH="$(TOOLCHAIN_PATH)"
BR2_TOOLCHAIN_EXTERNAL_CUSTOM_PREFIX="arm-linux-gnueabihf"
BR2_TOOLCHAIN_EXTERNAL_GCC_8=y
BR2_TOOLCHAIN_EXTERNAL_HEADERS_4_19=y
BR2_TOOLCHAIN_EXTERNAL_CUSTOM_GLIBC=y
BR2_TOOLCHAIN_EXTERNAL_CXX=y
BR2_TARGET_OPTIMIZATION="-pipe"
BR2_TARGET_GENERIC_HOSTNAME="default-hostname"
BR2_TARGET_GENERIC_ISSUE="default-issue"
BR2_TARGET_GENERIC_PASSWD_SHA512=y
BR2_ROOTFS_DEVICE_CREATION_DYNAMIC_MDEV=y
BR2_TARGET_GENERIC_ROOT_PASSWD="root"
# BR2_TARGET_GENERIC_GETTY is not set
BR2_TARGET_TZ_INFO=y
BR2_TARGET_LOCALTIME="UTC"
BR2_GLOBAL_PATCH_DIR="$(BR2_EXTERNAL_SBT_OPEN_SOURCE_PATH)/patches/"
BR2_ROOTFS_OVERLAY="$(BR2_EXTERNAL_SBT_OPEN_SOURCE_PATH)/board/common/rootfs_overlay/ $(BR2_EXTERNAL_SBT_PROPRIETARY_PATH)/board/green-mango/rootfs_overlay/"
BR2_PACKAGE_BUSYBOX_CONFIG="$(BR2_EXTERNAL_SBT_OPEN_SOURCE_PATH)/board/common/busybox.config"
BR2_PACKAGE_BUSYBOX_WATCHDOG=y
BR2_PACKAGE_BUSYBOX_WATCHDOG_PERIOD="45"
BR2_PACKAGE_XZ=y
BR2_PACKAGE_STRACE=y
BR2_PACKAGE_DOSFSTOOLS=y
BR2_PACKAGE_DOSFSTOOLS_FSCK_FAT=y
BR2_PACKAGE_E2FSPROGS=y
BR2_PACKAGE_MTD=y
# BR2_PACKAGE_MTD_FLASH_LOCK is not set
# BR2_PACKAGE_MTD_FLASH_UNLOCK is not set
BR2_PACKAGE_MTD_MKFSJFFS2=y
# BR2_PACKAGE_MTD_MTD_DEBUG is not set
# BR2_PACKAGE_MTD_NANDDUMP is not set
# BR2_PACKAGE_MTD_NANDTEST is not set
# BR2_PACKAGE_MTD_MTDINFO is not set
# BR2_PACKAGE_MTD_UBIATTACH is not set
# BR2_PACKAGE_MTD_UBICRC32 is not set
# BR2_PACKAGE_MTD_UBIDETACH is not set
# BR2_PACKAGE_MTD_UBIFORMAT is not set
# BR2_PACKAGE_MTD_UBIMKVOL is not set
# BR2_PACKAGE_MTD_UBINFO is not set
# BR2_PACKAGE_MTD_UBINIZE is not set
# BR2_PACKAGE_MTD_UBIRENAME is not set
# BR2_PACKAGE_MTD_UBIRMVOL is not set
# BR2_PACKAGE_MTD_UBIRSVOL is not set
# BR2_PACKAGE_MTD_UBIUPDATEVOL is not set
# BR2_PACKAGE_MTD_UBIBLOCK is not set
BR2_PACKAGE_LIBWEBSOCKETS=y
BR2_PACKAGE_MOSQUITTO=y
BR2_PACKAGE_FBV=y
# BR2_PACKAGE_FBV_JPEG is not set
# BR2_PACKAGE_FBV_GIF is not set
BR2_PACKAGE_QT5=y
BR2_PACKAGE_QT5BASE_WIDGETS=y
BR2_PACKAGE_QT5BASE_GUI=y
BR2_PACKAGE_QT5BASE_DEFAULT_QPA="linuxfb"
BR2_PACKAGE_QT5BASE_GIF=y
BR2_PACKAGE_QT5SVG=y
BR2_PACKAGE_UBOOT_TOOLS=y
BR2_PACKAGE_UBOOT_TOOLS_MKIMAGE=y
BR2_PACKAGE_UBOOT_TOOLS_MKENVIMAGE=y
BR2_PACKAGE_PYTHON3=y
BR2_PACKAGE_PYTHON3_READLINE=y
BR2_PACKAGE_PYTHON3_SQLITE=y
BR2_PACKAGE_PYTHON_AIOJOBS=y
BR2_PACKAGE_PYTHON_CHARDET=y
BR2_PACKAGE_PYTHON_JSONSCHEMA=y
BR2_PACKAGE_PYTHON_MSGPACK=y
BR2_PACKAGE_PYTHON_PSUTIL=y
BR2_PACKAGE_PYTHON_PYQT5=y
BR2_PACKAGE_PYTHON_UVLOOP=y
BR2_PACKAGE_PYTHON_WATCHDOG=y
BR2_PACKAGE_LIBARCHIVE=y
BR2_PACKAGE_GNUTLS=y
BR2_PACKAGE_SQLITE_ENABLE_JSON1=y
BR2_PACKAGE_LIBDRM=y
BR2_PACKAGE_LIBDAEMON=y
BR2_PACKAGE_LIBEVDEV=y
BR2_PACKAGE_LIBUNISTRING=y
BR2_PACKAGE_HAVEGED=y
BR2_PACKAGE_CHRONY=y
BR2_PACKAGE_DNSMASQ=y
# BR2_PACKAGE_DNSMASQ_TFTP is not set
BR2_PACKAGE_IPTABLES=y
BR2_PACKAGE_OPENSSH=y
BR2_PACKAGE_RSYNC=y
BR2_PACKAGE_WPA_SUPPLICANT=y
BR2_PACKAGE_WPA_SUPPLICANT_EAP=y
BR2_PACKAGE_WPA_SUPPLICANT_DEBUG_SYSLOG=y
BR2_PACKAGE_WPA_SUPPLICANT_WPS=y
BR2_PACKAGE_FILE=y
BR2_PACKAGE_LOGROTATE=y
BR2_PACKAGE_HTOP=y
BR2_PACKAGE_KMOD=y
BR2_PACKAGE_MONIT=y
BR2_PACKAGE_SWUPDATE=y
BR2_PACKAGE_SWUPDATE_CONFIG="$(BR2_EXTERNAL_SBT_OPEN_SOURCE_PATH)/board/common/swupdate.config"
BR2_PACKAGE_SWUPDATE_INSTALL_WEBSITE=n
BR2_PACKAGE_UTIL_LINUX_LIBMOUNT=y
BR2_TARGET_ROOTFS_CPIO=y
BR2_TARGET_ROOTFS_CPIO_GZIP=y
BR2_TARGET_ROOTFS_CPIO_UIMAGE=y
BR2_LINUX_KERNEL=y
BR2_LINUX_KERNEL_CUSTOM_TARBALL=y
BR2_LINUX_KERNEL_CUSTOM_TARBALL_LOCATION="$(call github,sbtinstruments,linux-xlnx,sbtOS-v2020.03.1).tar.gz"
BR2_LINUX_KERNEL_USE_DEFCONFIG=y
BR2_LINUX_KERNEL_DEFCONFIG="green_mango"
BR2_LINUX_KERNEL_UIMAGE=y
BR2_LINUX_KERNEL_UIMAGE_LOADADDR="0x8000"
# BR2_TARGET_ROOTFS_TAR is not set
BR2_PACKAGE_INFLUXDB=y
BR2_PACKAGE_INFLUXDB_COMPRESS_BINARIES=y
BR2_PACKAGE_TELEGRAF=y
BR2_PACKAGE_TELEGRAF_COMPRESS_BINARIES=y
BR2_PACKAGE_HOST_PYTHON_CYTHON=y
BR2_PACKAGE_PYTHON_AIOHTTP_SBT=y
BR2_PACKAGE_PYTHON_AIOSQL=y
BR2_PACKAGE_PYTHON_ASYNCQT=y
BR2_PACKAGE_PYTHON_ATTRS_USER=y
BR2_PACKAGE_PYTHON_DAEMON_SBT=y
BR2_PACKAGE_PYTHON_DISTRO=y
BR2_PACKAGE_PYTHON_IDNA_SSL=y
BR2_PACKAGE_PYTHON_JMESPATH=y
BR2_PACKAGE_PYTHON_JSONPATCH=y
BR2_PACKAGE_PYTHON_PY_SPY=y
BR2_PACKAGE_PYTHON_PYMPLER=y
BR2_PACKAGE_PYTHON_RESTRICTEDPYTHON=y
BR2_PACKAGE_RSYSLOG_USER=y
BR2_PACKAGE_PYTHON_BAXTER=y
BR2_PACKAGE_PYTHON_CELLMATE=y
BR2_PACKAGE_PYTHON_DASH=y
BR2_PACKAGE_PYTHON_GEIST=y
BR2_PACKAGE_PYTHON_MASKIN=y
BR2_PACKAGE_PYTHON_MESTER=y
BR2_PACKAGE_PYTHON_RXPY=y
BR2_PACKAGE_ZEUS_CONFIG=y
```

## sbt-proprietary/package/alg/Config.in
```kconfig
config BR2_PACKAGE_ALG
	bool "alg"
	select BR2_PACKAGE_BOOST
	select BR2_PACKAGE_BOOST_DATE_TIME
	select BR2_PACKAGE_BOOST_FILESYSTEM
	select BR2_PACKAGE_BOOST_IOSTREAMS
	select BR2_PACKAGE_BOOST_LOG
	select BR2_PACKAGE_BOOST_SYSTEM
	select BR2_PACKAGE_BOOST_THREAD
	select BR2_PACKAGE_DLIB
	help
	  Bacteria detection algorithms
```

## sbt-proprietary/package/bactobox-config/Config.in
```kconfig
config BR2_PACKAGE_BACTOBOX_CONFIG
	bool "bactobox-config"
	help
	  BactoBox configuration files for /etc
```

## sbt-proprietary/package/lab/Config.in
```kconfig
config BR2_PACKAGE_LAB
	bool "lab"
	help
	  Lab is an internal tool by SBT Instruments.

	  https://github.com/sbtinstruments/lab
```

## sbt-proprietary/package/python-algpy/Config.in
```kconfig
config BR2_PACKAGE_PYTHON_ALGPY
	bool "alg.py"
	select BR2_PACKAGE_ALG
	select BR2_PACKAGE_HOST_PYBIND11
	depends on BR2_PACKAGE_PYTHON3
	help
	  Python wrappers for the bacteria detection algorithms
```

## sbt-proprietary/package/python-baxter/Config.in
```kconfig
config BR2_PACKAGE_PYTHON_BAXTER
	bool "python-baxter"
	select BR2_PACKAGE_PYTHON_ALGPY
	help
	  Measurement gateway
```

## sbt-proprietary/package/python-cellmate/Config.in
```kconfig
config BR2_PACKAGE_PYTHON_CELLMATE
	bool "python-cellmate"
	select BR2_PACKAGE_PYTHON_GEIST # runtime
	help
	  FlowCell control
```
