## sbt-proprietary/package/python-dash/Config.in
```kconfig
config BR2_PACKAGE_PYTHON_DASH
	bool "python-dash"
	depends on BR2_PACKAGE_PYTHON_PYQT5 # runtime
	depends on BR2_PACKAGE_PYTHON_QTAWESOME # runtime
	select BR2_PACKAGE_PYTHON_GEIST # runtime
	select BR2_PACKAGE_PYTHON_PSUTIL # runtime
	help
	  Dashboard interface
```

## sbt-proprietary/package/python-dash38/Config.in
```kconfig
config BR2_PACKAGE_PYTHON_DASH38
	bool "python-dash38"
	depends on BR2_PACKAGE_PYTHON_PYQT5 # runtime
	depends on BR2_PACKAGE_PYTHON_QTAWESOME # runtime
	select BR2_PACKAGE_PYTHON_GEIST # runtime
	select BR2_PACKAGE_PYTHON_PSUTIL # runtime
	select BR2_PACKAGE_PYTHON_UTMP # runtime
	help
	  Dashboard interface
```

## sbt-proprietary/package/python-frog/Config.in
```kconfig
config BR2_PACKAGE_PYTHON_FROG
	bool "python-frog"
	select BR2_PACKAGE_PYTHON_GEIST # runtime
	help
	  CSV summary generator daemon
```

## sbt-proprietary/package/python-geist/Config.in
```kconfig
config BR2_PACKAGE_PYTHON_GEIST
	bool "python-geist"
	select BR2_PACKAGE_PYTHON_AIOHTTP_SBT # runtime
	select BR2_PACKAGE_PYTHON_AIOSQL # runtime
	select BR2_PACKAGE_PYTHON_DAEMON_SBT # runtime
	select BR2_PACKAGE_PYTHON_JMESPATH # runtime
	select BR2_PACKAGE_PYTHON_JSONPATCH # runtime
	select BR2_PACKAGE_PYTHON_JSONSCHEMA # runtime
	select BR2_PACKAGE_PYTHON_RESTRICTEDPYTHON # runtime
	help
	  Daemonize a python program
```

## sbt-proprietary/package/python-maskin/Config.in
```kconfig
config BR2_PACKAGE_PYTHON_MASKIN
	bool "python-maskin"
	select BR2_PACKAGE_PYTHON_GEIST # runtime
	help
	  Peripheral management
```

## sbt-proprietary/package/python-mester/Config.in
```kconfig
config BR2_PACKAGE_PYTHON_MESTER
	bool "python-mester"
	select BR2_PACKAGE_PYTHON_GEIST # runtime
	help
	  Run custom and pre-defined programs
```

## sbt-proprietary/package/python-staten/Config.in
```kconfig
config BR2_PACKAGE_PYTHON_STATEN
	bool "python-staten"
	select BR2_PACKAGE_PYTHON_GEIST # runtime
	select BR2_PACKAGE_PYTHON_ASYNCIO_MQTT # runtime
	help
	  State management
```

## sbt-proprietary/package/rm-neue/Config.in
```kconfig
config BR2_PACKAGE_RM_NEUE
	bool "rm-neue"
	help
	  RM Neue is a font by CoType Foundry.

	  https://cotypefoundry.com/our-fonts/rm-neue/
```

## sbt-proprietary/package/zeus-config/Config.in
```kconfig
config BR2_PACKAGE_ZEUS_CONFIG
	bool "zeus-config"
	help
	  Zeus configuration files for /etc
```
