## external/Config.in
```kconfig
source "$BR2_EXTERNAL_SBT_AQUA_PATH/package/python-aiohttp/Config.in"
source "$BR2_EXTERNAL_SBT_AQUA_PATH/package/python-aiojobs/Config.in"
source "$BR2_EXTERNAL_SBT_AQUA_PATH/package/python-async_exit_stack/Config.in"
source "$BR2_EXTERNAL_SBT_AQUA_PATH/package/python-async_timeout/Config.in"
source "$BR2_EXTERNAL_SBT_AQUA_PATH/package/python-attrs-user/Config.in"
source "$BR2_EXTERNAL_SBT_AQUA_PATH/package/python-cchardet/Config.in"
source "$BR2_EXTERNAL_SBT_AQUA_PATH/package/python-distro/Config.in"
source "$BR2_EXTERNAL_SBT_AQUA_PATH/package/python-idna_ssl/Config.in"
source "$BR2_EXTERNAL_SBT_AQUA_PATH/package/python-jmespath/Config.in"
source "$BR2_EXTERNAL_SBT_AQUA_PATH/package/python-jsonpatch/Config.in"
source "$BR2_EXTERNAL_SBT_AQUA_PATH/package/python-jsonpointer/Config.in"
source "$BR2_EXTERNAL_SBT_AQUA_PATH/package/python-multidict/Config.in"
source "$BR2_EXTERNAL_SBT_AQUA_PATH/package/python-py-spy/Config.in"
source "$BR2_EXTERNAL_SBT_AQUA_PATH/package/python-pympler/Config.in"
source "$BR2_EXTERNAL_SBT_AQUA_PATH/package/python-restrictedpython/Config.in"
source "$BR2_EXTERNAL_SBT_AQUA_PATH/package/python-rxpy/Config.in"
source "$BR2_EXTERNAL_SBT_AQUA_PATH/package/python-uvloop/Config.in"
source "$BR2_EXTERNAL_SBT_AQUA_PATH/package/python-yarl/Config.in"
source "$BR2_EXTERNAL_SBT_AQUA_PATH/package/rsyslog-user/Config.in"
source "$BR2_EXTERNAL_SBT_AQUA_PATH/package/swupdate-user/Config.in"
source "$BR2_EXTERNAL_SBT_AQUA_PATH/package/uchardet/Config.in"
```

## external/package/python-aiohttp/Config.in
```kconfig
config BR2_PACKAGE_PYTHON_AIOHTTP
	bool "python-aiohttp"
	select BR2_PACKAGE_PYTHON_ASYNC_TIMEOUT
	select BR2_PACKAGE_PYTHON_CHARDET
	select BR2_PACKAGE_PYTHON_MULTIDICT
	select BR2_PACKAGE_PYTHON_YARL
	help
	  HTTP client/server for asyncio (PEP 3156).

	  https://aiohttp.readthedocs.io/en/stable/
```

## external/package/python-async_exit_stack/Config.in
```kconfig
config BR2_PACKAGE_PYTHON_ASYNC_EXIT_STACK
	bool "python-async_exit_stack"
	help
	  AsyncExitStack backport for Python 3.5+

	  https://github.com/sorcio/async_exit_stack
```

## external/package/python-async_timeout/Config.in
```kconfig
config BR2_PACKAGE_PYTHON_ASYNC_TIMEOUT
	bool "python-async_timeout"
	help
	  asyncio-compatible timeout context manager.

	  https://github.com/aio-libs/async_timeout
```

## external/package/python-cchardet/Config.in
```kconfig
config BR2_PACKAGE_PYTHON_CCHARDET
	bool "python-cchardet"
	help
	  cChardet is high speed universal character encoding detector. - binding to uchardet.

	  https://github.com/PyYoshi/cChardet
```

## external/package/python-chardet/Config.in
```kconfig
config BR2_PACKAGE_PYTHON_CHARDET
	bool "python-chardet"
	help
	  This is a continuation of Mark Pilgrim's excellent chardet.
	  Previously, two versions needed to be maintained: one that
	  supported python 2.x and one that supported python 3.x. We've
	  recently merged with Ian Cordasco's charade fork, so now we
	  have one coherent version that works for Python 2.6+.

	  https://github.com/chardet/chardet
```

## external/package/python-distro/Config.in
```kconfig
config BR2_PACKAGE_PYTHON_DISTRO
	bool "python-distro"
	help
	  A much more elaborate, renewed alternative implementation for Python's
	  platform.linux_distribution().

	  http://distro.readthedocs.io/
```

## external/package/python-jmespath/Config.in
```kconfig
config BR2_PACKAGE_PYTHON_JMESPATH
	bool "python-jmespath"
	help
	  JMESPath is a query language for JSON.

	  http://jmespath.org/
```

## external/package/python-jsonpatch/Config.in
```kconfig
config BR2_PACKAGE_PYTHON_JSONPATCH
	bool "python-jsonpatch"
	help
	  Applying JSON Patches in Python.

	  https://github.com/stefankoegl/python-json-patch
```

## external/package/python-multidict/Config.in
```kconfig
config BR2_PACKAGE_PYTHON_MULTIDICT
	bool "python-multidict"
	help
	  HTTP Headers and URL query string require specific
	  data structure: multidict. It behaves mostly like
	  a dict but it can have several values for the same
	  key.

	  https://github.com/aio-libs/multidict/
```

## external/package/python-py-spy/Config.in
```kconfig
config BR2_PACKAGE_PYTHON_PY_SPY
	bool "python-py-spy"
	select BR2_PACKAGE_HOST_RUSTC
	select BR2_PACKAGE_HOST_CARGO
	help
	  Sampling profiler for Python programs.

	  https://github.com/benfred/py-spy
```

## external/package/python-rxpy/Config.in
```kconfig
config BR2_PACKAGE_PYTHON_RXPY
	bool "python-rxpy"
	help
	  A library for composing asynchronous and event-based
	  programs using observable collections and LINQ-style
	  query operators in Python.

	  https://github.com/ReactiveX/RxPY
```

## external/package/python-uvloop/Config.in
```kconfig
config BR2_PACKAGE_PYTHON_UVLOOP
	bool "python-uvloop"
	select BR2_PACKAGE_LIBUV
	help
	  Ultra fast implementation of asyncio event loop on top of libuv.

	  https://github.com/MagicStack/uvloop
```

## external/package/python-yarl/Config.in
```kconfig
config BR2_PACKAGE_PYTHON_YARL
	bool "python-yarl"
	help
	  Yet another URL library

	  http://pythonhosted.org/yarl/
```

## external/package/uchardet/Config.in
```kconfig
config BR2_PACKAGE_UCHARDET
	bool "uchardet"
	help
	  uchardet is an encoding detector library, which takes a sequence of bytes
	  in an unknown character encoding and attempts to determine the encoding
	  of the text. Returned encoding names are iconv-compatible.

	  https://github.com/PyYoshi/uchardet
```

## sbt-open-source/Config.in
```kconfig
source "$BR2_EXTERNAL_SBT_OPEN_SOURCE_PATH/package/influxdb/Config.in"
source "$BR2_EXTERNAL_SBT_OPEN_SOURCE_PATH/package/dlib/Config.in"
source "$BR2_EXTERNAL_SBT_OPEN_SOURCE_PATH/package/python-aiohttp-sbt/Config.in"
source "$BR2_EXTERNAL_SBT_OPEN_SOURCE_PATH/package/python-aiosql/Config.in"
source "$BR2_EXTERNAL_SBT_OPEN_SOURCE_PATH/package/python-asyncio-mqtt/Config.in"
source "$BR2_EXTERNAL_SBT_OPEN_SOURCE_PATH/package/python-attrs-user/Config.in"
source "$BR2_EXTERNAL_SBT_OPEN_SOURCE_PATH/package/python-babel-sbt/Config.in"
source "$BR2_EXTERNAL_SBT_OPEN_SOURCE_PATH/package/python-daemon-sbt/Config.in"
source "$BR2_EXTERNAL_SBT_OPEN_SOURCE_PATH/package/python-distro/Config.in"
source "$BR2_EXTERNAL_SBT_OPEN_SOURCE_PATH/package/python-evdev-sbt/Config.in"
source "$BR2_EXTERNAL_SBT_OPEN_SOURCE_PATH/package/python-idna_ssl/Config.in"
source "$BR2_EXTERNAL_SBT_OPEN_SOURCE_PATH/package/python-jmespath-sbt/Config.in"
source "$BR2_EXTERNAL_SBT_OPEN_SOURCE_PATH/package/python-jsonpatch/Config.in"
source "$BR2_EXTERNAL_SBT_OPEN_SOURCE_PATH/package/python-jsonpointer/Config.in"
source "$BR2_EXTERNAL_SBT_OPEN_SOURCE_PATH/package/python-py-spy/Config.in"
source "$BR2_EXTERNAL_SBT_OPEN_SOURCE_PATH/package/python-pympler/Config.in"
source "$BR2_EXTERNAL_SBT_OPEN_SOURCE_PATH/package/python-pydantic-sbt/Config.in"
source "$BR2_EXTERNAL_SBT_OPEN_SOURCE_PATH/package/python-rxpy/Config.in"
source "$BR2_EXTERNAL_SBT_OPEN_SOURCE_PATH/package/python-rxpy-sbt/Config.in"
source "$BR2_EXTERNAL_SBT_OPEN_SOURCE_PATH/package/python-paho-mqtt-sbt/Config.in"
source "$BR2_EXTERNAL_SBT_OPEN_SOURCE_PATH/package/python-qasync/Config.in"
source "$BR2_EXTERNAL_SBT_OPEN_SOURCE_PATH/package/python-qtawesome/Config.in"
source "$BR2_EXTERNAL_SBT_OPEN_SOURCE_PATH/package/python-qtpy/Config.in"
source "$BR2_EXTERNAL_SBT_OPEN_SOURCE_PATH/package/python-swu-client/Config.in"
source "$BR2_EXTERNAL_SBT_OPEN_SOURCE_PATH/package/python-typing-extensions/Config.in"
source "$BR2_EXTERNAL_SBT_OPEN_SOURCE_PATH/package/python-utmp/Config.in"
source "$BR2_EXTERNAL_SBT_OPEN_SOURCE_PATH/package/telegraf/Config.in"
source "$BR2_EXTERNAL_SBT_OPEN_SOURCE_PATH/package/uchardet/Config.in"
source "$BR2_EXTERNAL_SBT_OPEN_SOURCE_PATH/package/python-tinydb/Config.in"
```

## sbt-open-source/package/dlib/Config.in
```kconfig
config BR2_PACKAGE_DLIB
	bool "dlib"
	depends on BR2_INSTALL_LIBSTDCPP
	depends on BR2_TOOLCHAIN_HAS_THREADS
	help
	  Dlib is a modern C++ toolkit containing machine learning
	  algorithms and tools for creating complex software in C++
	  to solve real world problems. It is used in both industry
	  and academia in a wide range of domains including robotics,
	  embedded devices, mobile phones, and large high performance
	  computing environments. Dlib's open source licensing allows
	  you to use it in any application, free of charge.

	  http://dlib.net

if BR2_PACKAGE_DLIB

config BR2_PACKAGE_DLIB_PYTHON_MODULE
	bool "python-dlib"
	depends on BR2_PACKAGE_PYTHON || BR2_PACKAGE_PYTHON3
	help
	  This option provide the dlib python module.

	  http://dlib.net

endif

comment "dlib needs a toolchain w/ C++, threads"
	depends on !(BR2_powerpc && BR2_TOOLCHAIN_USES_UCLIBC)
	depends on BR2_PACKAGE_OPENBLAS_ARCH_SUPPORTS
	depends on BR2_PACKAGE_XORG7
	depends on !BR2_INSTALL_LIBSTDCPP || !BR2_TOOLCHAIN_HAS_THREADS \
		|| !BR2_TOOLCHAIN_HAS_FORTRAN
```

## sbt-open-source/package/influxdb/Config.in
```kconfig
config BR2_PACKAGE_INFLUXDB
	bool "influxdb"
	help
	  Scalable datastore for metrics, events, and real-time analytics

	  https://influxdata.com

config BR2_PACKAGE_INFLUXDB_COMPRESS_BINARIES
	bool "attempt to shrink the resulting binaries"
```

## sbt-open-source/package/python-aiosql/Config.in
```kconfig
config BR2_PACKAGE_PYTHON_AIOSQL
	bool "python-aiosql"
	help
	  Simple SQL in Python

	  https://github.com/nackjicholson/aiosql
```

## sbt-open-source/package/python-asyncio-mqtt/Config.in
```kconfig
config BR2_PACKAGE_PYTHON_ASYNCIO_MQTT
	bool "python-asyncio-mqtt"
	select BR2_PACKAGE_PYTHON_PAHO_MQTT_SBT # runtime
	help
	  Idomatic asyncio wrapper around paho-mqtt

	  https://github.com/sbtinstruments/asyncio-mqtt
```

## sbt-open-source/package/python-asyncqt/Config.in
```kconfig
config BR2_PACKAGE_PYTHON_ASYNCQT
	bool "python-asyncqt"
	help
	  asyncqt is an implementation of the PEP 3156 event-loop with Qt.
	  This package is a fork of quamash focusing on modern Python versions,
	  with some extra utilities, examples and simplified CI.

	  https://github.com/gmarull/asyncqt
```

## sbt-open-source/package/python-babel-sbt/Config.in
```kconfig
config BR2_PACKAGE_PYTHON_BABEL_SBT
	bool "python-babel-sbt"
	select BR2_PACKAGE_PYTHON_PYTZ # runtime
	help
	  A collection of tools for internationalizing Python
	  applications.

	  http://babel.pocoo.org/en/latest/

if BR2_PACKAGE_PYTHON_BABEL_SBT

config BR2_PACKAGE_PYTHON_BABEL_SBT_LOCALE_DATA_PURGE_EXPR
	string "purge locale data"
	help
	  Remove all locale data that matches this expression.
	  Locale data takes up around 20 MiB of space uncompressed.
	  Use this config entry to reduce that size.

endif
```

## sbt-open-source/package/python-daemon-sbt/Config.in
```kconfig
config BR2_PACKAGE_PYTHON_DAEMON_SBT
	bool "python-daemon-sbt"
	help
	  Library to implement a well-behaved Unix daemon process.

	  https://pypi.python.org/pypi/python-daemon/
```

## sbt-open-source/package/python-evdev-sbt/Config.in
```kconfig
config BR2_PACKAGE_PYTHON_EVDEV_SBT
	bool "python-evdev-sbt"
	help
	  This package provides bindings to the generic input event interface
	  in Linux. The evdev interface serves the purpose of passing events
	  generated in the kernel directly to userspace through character
	  devices that are typically located in /dev/input/.

	  https://pypi.org/project/evdev/
```

## sbt-open-source/package/python-idna_ssl/Config.in
```kconfig
config BR2_PACKAGE_PYTHON_IDNA_SSL
	bool "python-idna_ssl"
	help
	  Patch ssl.match_hostname for Unicode(idna) domains support

	  https://pypi.python.org/pypi/idna_ssl
```
